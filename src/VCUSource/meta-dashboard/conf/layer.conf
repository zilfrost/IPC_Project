## src/VCUSource/meta-dashboard/conf/layer.conf
```bitbake
BBPATH .= ":${LAYERDIR}"

BBFILES += "${LAYERDIR}/recipes-*/*/*.bb \
            ${LAYERDIR}/recipes-*/*/*.bbappend"

BBFILE_COLLECTIONS += "meta-dashboard"
BBFILE_PATTERN_meta-dashboard = "^${LAYERDIR}/"
BBFILE_PRIORITY_meta-dashboard = "10"

# Requires: OE-core + meta-qt5 (provides the "qt5" collection)
LAYERDEPENDS_meta-dashboard = "core qt5-layer"

# Tested against Yocto 5.0 Scarthgap
LAYERSERIES_COMPAT_meta-dashboard = "scarthgap"
```

## src/meta-linkupcan/conf/layer.conf
```bitbake
BBPATH .= ":${LAYERDIR}"
BBFILES += "${LAYERDIR}/recipes-*/*/*.bb \
            ${LAYERDIR}/recipes-*/*/*.bbappend"

BBFILE_COLLECTIONS += "meta-linkupcan"
BBFILE_PATTERN_meta-linkupcan = "^${LAYERDIR}/"
BBFILE_PRIORITY_meta-linkupcan = "8"

LAYERDEPENDS_meta-linkupcan = "core"
LAYERSERIES_COMPAT_meta-linkupcan = "scarthgap"
```

## src/meta-mcp2515-pi5/conf/layer.conf
```bitbake
BBPATH .= ":${LAYERDIR}"
BBFILES += "${LAYERDIR}/recipes-*/*/*.bb \
            ${LAYERDIR}/recipes-*/*/*.bbappend"

BBFILE_COLLECTIONS += "mcp2515-pi5"
BBFILE_PATTERN_mcp2515-pi5 = "^${LAYERDIR}/"
BBFILE_PRIORITY_mcp2515-pi5 = "7"

LAYERDEPEND_mcp2515-pi5 = "core"
LAYERSERIES_COMPAT_mcp2515-pi5 = "scarthgap"
```

## src/meta-mywifi/conf/layer.conf
```bitbake
# We have a conf and classes directory, add to BBPATH
BBPATH .= ":${LAYERDIR}"

# We have recipes-* directories, add to BBFILES
BBFILES += "${LAYERDIR}/recipes-*/*/*.bb \
            ${LAYERDIR}/recipes-*/*/*.bbappend"

BBFILE_COLLECTIONS += "meta-mywifi"
BBFILE_PATTERN_meta-mywifi = "^${LAYERDIR}/"
BBFILE_PRIORITY_meta-mywifi = "6"

LAYERDEPENDS_meta-mywifi = "core"
LAYERSERIES_COMPAT_meta-mywifi = "scarthgap"
```
